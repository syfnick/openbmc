## vscode-bitbake-build/conf/bblayers.conf
```bitbake
# POKY_BBLAYERS_CONF_VERSION is increased each time build/conf/bblayers.conf
# changes incompatibly
POKY_BBLAYERS_CONF_VERSION = "2"

BBPATH = "${TOPDIR}"
BBFILES ?= ""

BBLAYERS ?= " \
  /home/syfnick/openbmc/meta \
  /home/syfnick/openbmc/meta-poky \
  /home/syfnick/openbmc/meta-yocto-bsp \
  "
```
